/*
 * SPDX-FileCopyrightText: (c) 2025 Tenstorrent AI ULC
 *
 * SPDX-License-Identifier: Apache-2.0
 */

MEMORY
{
    TRISC0_LOCAL_DATA_MEM : ORIGIN = 0x802000, LENGTH = (2 * 1024) - 256
    TRISC1_LOCAL_DATA_MEM : ORIGIN = 0x804000, LENGTH = (2 * 1024) - 256
    TRISC2_LOCAL_DATA_MEM : ORIGIN = 0x806000, LENGTH = (2 * 1024) - 768

    TRISC0_STACK_MEM : ORIGIN = (0x802000 + (2 * 1024) - 256), LENGTH = 256
    TRISC1_STACK_MEM : ORIGIN = (0x804000 + (2 * 1024) - 256), LENGTH = 256
    TRISC2_STACK_MEM : ORIGIN = (0x806000 + (2 * 1024) - 768), LENGTH = 768

    TRISC0_CODE : ORIGIN = ((2048 + 512)), LENGTH = (16 * 1024)
    TRISC1_CODE : ORIGIN = ((2048 + 512) + (16 * 1024)), LENGTH = (16 * 1024)
    TRISC2_CODE : ORIGIN = ((2048 + 512) + (16 * 1024) + (16 * 1024)), LENGTH = (16 * 1024)

    TRISC0_LOADER_INIT_MEM : ORIGIN = (51712), LENGTH = (2 * 1024)
    TRISC1_LOADER_INIT_MEM : ORIGIN = (51712 + (2 * 1024)), LENGTH = (2 * 1024)
    TRISC2_LOADER_INIT_MEM : ORIGIN = (51712 + (2 * 1024) + (2 * 1024)), LENGTH = (2 * 1024)

    TRISC0_LOADER_CODE_MEM : ORIGIN = 57856, LENGTH = 0
    TRISC1_LOADER_CODE_MEM : ORIGIN = 57856, LENGTH = 0
    TRISC2_LOADER_CODE_MEM : ORIGIN = 57856, LENGTH = 0

    BRISC_LOCAL_DATA_MEM : ORIGIN = 57856, LENGTH = 0
    NCRISC_LOCAL_DATA_MEM : ORIGIN = 57856, LENGTH = 0
    BRISC_STACK_MEM : ORIGIN = 57856, LENGTH = 0
    NCRISC_STACK_MEM : ORIGIN = 57856, LENGTH = 0
    BRISC_CODE : ORIGIN = 57856, LENGTH = 0
    NCRISC_CODE : ORIGIN = 57856, LENGTH = 0
    BRISC_LOADER_INIT_MEM : ORIGIN = 57856, LENGTH = 0
    NCRISC_LOADER_INIT_MEM : ORIGIN = 57856, LENGTH = 0
    BRISC_LOADER_CODE_MEM : ORIGIN = 57856, LENGTH = 0
    NCRISC_LOADER_CODE_MEM : ORIGIN = 57856, LENGTH = 0
}
PROVIDE(__instrn_buffer = 0x0080e000);
